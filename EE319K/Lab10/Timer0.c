// Timer0.c
// Runs on LM4F120/TM4C123
// Use TIMER0 in 32-bit periodic mode to request interrupts at a periodic rate
// Daniel Valvano
// Last Modified: 3/6/2015 
// You can use this timer only if you learn how it works


#include <stdint.h>
#include "tm4c123gh6pm.h"
#include "Sound.h"
#include "DAC.h"

unsigned char Place[] = {16,15,16,15,16,15,16,16,16,15,16,16,16,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15,200};
unsigned char Damage[] = {16,16,16,16,16,16,16,16,16,16,16,20,20,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15,200};
unsigned char Explode[] = {15,16,15,16,15,16,15,16,15,16,15,15,16,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15,200};

unsigned int i1 = 0; unsigned int i2 = 0; unsigned int i3 = 0; unsigned int i4 = 0;
const unsigned char SineWave[32] = {0,0,0,0,1,1,2,3,5,6,7,9,11,12,13,14,14,15,15,15,14,14,13,12,10,9,7,6,5,3,2,1};
unsigned char Index;
	
// ***************** Timer0_Init ****************
// Activate TIMER0 interrupts to run user task periodically
// Inputs:  task is a pointer to a user function
//          period in units (1/clockfreq)
// Outputs: none
void Timer0_Init(uint32_t period){
  SYSCTL_RCGCTIMER_R |= 0x01;   // 0) activate TIMER0
  TIMER0_CTL_R = 0x00000000;    // 1) disable TIMER0A during setup
  TIMER0_CFG_R = 0x00000000;    // 2) configure for 32-bit mode
  TIMER0_TAMR_R = 0x00000002;   // 3) configure for periodic mode, default down-count settings
  TIMER0_TAILR_R = period-1;    // 4) reload value
  TIMER0_TAPR_R = 0;            // 5) bus clock resolution
  TIMER0_ICR_R = 0x00000001;    // 6) clear TIMER0A timeout flag
  TIMER0_IMR_R = 0x00000001;    // 7) arm timeout interrupt
  NVIC_PRI4_R = (NVIC_PRI4_R&0x00FFFFFF)|0x80000000; // 8) priority 4
	// interrupts enabled in the main program after all devices initialized
// vector number 35, interrupt number 19
  NVIC_EN0_R = 1<<19;           // 9) enable IRQ 19 in NVIC
  TIMER0_CTL_R &= ~0x00000001;    // 10) enable TIMER0A
}

void Timer0A_Handler(void){
  TIMER0_ICR_R = TIMER_ICR_TATOCINT;// acknowledge TIMER0A timeout
	
	//We play only if there's a sound to be played 
  if(Sound!=0){
		
		//Sound = 1 is for bomb placement 
		if (Sound==1){
		  if (Place[i1]<100){
				DAC_Out(Place[i1]);
				i1++;
			}
			else{
				i1 = 0;
				Sound = 0;
				TIMER0_CTL_R &= ~0x00000001; // disable
			}
		}
		
		//Sound == 2 is for bomb exploding 
		if (Sound==2){
			
			 if (Place[i2]<100){
				DAC_Out(Explode[i2]);
				i2++;
			}
			else{
				i2 = 0;
				Sound = 0;
				TIMER0_CTL_R &= ~0x00000001; // disable
			}
		}
		//Sound == 3 is for damage
		if (Sound ==3){
			 if (Place[i3]<100){
				DAC_Out(Damage[i3]);
				i3++;
			}
			else{
				i3 = 0;
				Sound = 0;
				TIMER0_CTL_R &= ~0x00000001; // disable
				}
			}
		}
	}